## arch/arm/mach-owl/Kconfig
```kconfig
if ARCH_OWL

menu "Actions OWL options"



config ARCH_OWL_ATS3605_SOC
	bool "Enable support for ATS3605 family"

	help
	  Support for Actions ATS3605 processor family, based on the
	  ARM CortexA5 SMP CPU


endmenu

endif
```

## drivers/gpu/drm/owl/Kconfig
```kconfig
config DRM_OWL
	tristate "DRM Support for Owl Soc"
	depends on DRM
	select DRM_KMS_HELPER
	select FB_SYS_FILLRECT
	select FB_SYS_COPYAREA
	select FB_SYS_IMAGEBLIT
	select FB_SYS_FOPS
	select VT_HW_CONSOLE_BINDING if FRAMEBUFFER_CONSOLE
	default n
	help
	  Choose this option if you have a Owl SoC chipset.
	  If M is selected the module will be called owldrm.

config DRM_OWL_LCD
	  bool "Owl DRM LCD"
	  depends on DRM_OWL 
	  select FB_MODE_HELPERS
	  select VIDEOMODE_HELPERS
	  help
	  Choose this option if you want to use Owl LCD for DRM.

config DRM_OWL_HDMI
	bool "Owl DRM HDMI"
	depends on DRM_OWL
	help
	  Choose this option if you want to use Owl HDMI for DRM.

config DRM_OWL_HDMI_FAKE_LCD_MODE
	bool "Owl DRM HDMI Fake The LCD Mode Support"
	depends on DRM_OWL_LCD && DRM_OWL_HDMI
	help
	  Choose this option if you want HDMI fake the lcd resolution(mode) support.
	  It may be helpful in Xorg dual screen extension.
```

## drivers/media/i2c/camera/Kconfig
```kconfig
#
# Actions CPU si or isp driver and the camera sensors of Actions support 
#
# 

source "drivers/media/i2c/camera/owl_host/Kconfig"
source "drivers/media/i2c/camera/owl_isp/Kconfig"
source "drivers/media/i2c/camera/owl_imx/Kconfig"
source "drivers/media/i2c/camera/ov5645/Kconfig"
source "drivers/media/i2c/camera/imx0219/Kconfig"
source "drivers/media/i2c/camera/gc5004/Kconfig"
source "drivers/media/i2c/camera/gc2755/Kconfig"
source "drivers/media/i2c/camera/gs5604/Kconfig"
source "drivers/media/i2c/camera/ov2685/Kconfig"
source "drivers/media/i2c/camera/flashlight/Kconfig"
```

## drivers/media/i2c/camera/ark7116/Kconfig
```kconfig
#
# Actions CPU si or isp driver and the camera sensors of Actions support 
#
# 

config ARK7116
	tristate "ARK7116 camera sensor driver"
	depends on VIDEO_V4L2 && I2C
	help
	  Support for ARK7116 module

	  To compile this driver as a module, choose M here: the
	  module will be called ARK7116.
```

## drivers/media/i2c/camera/gc2145/Kconfig
```kconfig
#
# Actions CPU si or isp driver and the camera sensors of Actions support 
#
# 

config GC2145
	tristate "GC2145 camera sensor driver"
	depends on VIDEO_V4L2 && I2C
	help
	  Support for GC2145 camera

	  To compile this driver as a module, choose M here: the
	  module will be called GC2145.
```

## drivers/media/i2c/camera/nt99141/Kconfig
```kconfig
#
# Actions CPU si or isp driver and the camera sensors of Actions support 
#
# 

config NT99141
	tristate "NT99141 camera sensor driver"
	depends on VIDEO_V4L2 && I2C
	help
	  Support for NT99141 camera

	  To compile this driver as a module, choose M here: the
	  module will be called NT99141.
```

## drivers/media/i2c/camera/owl_host/Kconfig
```kconfig
#
# Actions CPU si or isp driver and the camera sensors of Actions support 
#
# 

config OWL_CAMERA_HOST
	tristate "owl camera host driver"
	depends on VIDEO_V4L2
	help
	  Support for owl camera si

	  To compile this driver as a module, choose M here: the
	  module will be called owl camera.
```

## drivers/media/i2c/camera/owl_legacy_si/Kconfig
```kconfig
#
# Actions CPU camera legacy si driver and the camera sensors of Actions support 
#
# 

config OWL_CAMERA_LEGACY_SI
	tristate "Actions Legacy OWL Camera SI Driver"
	depends on VIDEO_V4L2 && ARCH_OWL_ATS3605_SOC
	help
	  Legacy camera si driver only fix for ats3605 soc.

	  To compile this driver as a module, choose M here: the
	  module will be called owl camera.
```

## drivers/media/i2c/camera/s5k4ec/Kconfig
```kconfig
#
# Actions CPU si or isp driver and the camera sensors of Actions support 
#
# 

config S5K4EC
	tristate "s5k4ec camera sensor driver"
	depends on VIDEO_V4L2 && I2C
	help
	  Support for s5k4ec camera

	  To compile this driver as a module, choose M here: the
	  module will be called s5k4ec.
```

## drivers/net/wireless/owl/Kconfig
```kconfig
config BCMDHD
	tristate "Broadcom 4329/30 wireless cards support"
	---help---
	  This module adds support for wireless adapters based on
	  Broadcom 4329/30 chipset.
	  
config BCMDHD_AP6335
	tristate "Broadcom AP6335 wireless cards support"
	---help---
	  This module adds support for wireless adapters based on
	  Broadcom AP6335 module chipset.

config RTL8723BS
	tristate "Realtek rtl8723bs wireless modules cards support"
	---help---
	  This module adds support for wireless adapters based on
	  sdio.
	  
config RTL8723VQ0
	tristate "Realtek rtl8723bs-vq0 wireless modules cards support"
	---help---
	  This module adds support for wireless adapters based on
	  sdio.
	  
config RTL8723BU
	tristate "Realtek rtl8723bu wireless modules cards support"
	---help---
	  This module adds support for wireless adapters based on
	  usb.
```

## drivers/pinctrl/owl/Kconfig
```kconfig
#
# Actions OWL SoCs pinctrl drivers
#

if ARCH_OWL

config PINCTRL_OWL
	bool
	select PINMUX
	select GENERIC_PINCONF

config PINCTRL_S900
	bool "Actions S900 pin controller driver"
	depends on ARCH_OWL
	select PINCTRL_OWL
	help
	  Say yes here to support the gpio/pin control module on
	  Actions S900 SoC.
config PINCTRL_S700
	bool "Actions S700 pin controller driver"
	depends on ARCH_OWL
	select PINCTRL_OWL
	help
	  Say yes here to support the gpio/pin control module on
	  Actions S700 SoC.

config PINCTRL_ATS3605
	bool "Actions ATS3605 pin controller driver"
	depends on ARCH_OWL
	select PINCTRL_OWL
	help
	  Say yes here to support the gpio/pin control module on
	  Actions ATS3605 SoC.
endif
```

## drivers/usb/legacy/Kconfig
```kconfig
config USB_LEGACY
	tristate "Actions legacy usb drivers"
	depends on USB
	---help---
	  used to support Actions legacy usb drivers.

if USB_LEGACY

source "drivers/usb/legacy/aotg_udc/Kconfig"
source "drivers/usb/legacy/aotg_hcd/Kconfig"
source "drivers/usb/legacy/monitor/Kconfig"

endif
```

## drivers/usb/legacy/aotg_hcd/Kconfig
```kconfig
config USB_LEGACY_AOTG_HCD
	tristate "Actions legacy usb2.0 hcd support"
	depends on USB_LEGACY
	default n
	---help---
	  The Actions chips have USB2.0 otg controllers. Enable
	  this option if your board uses this chip. If unsure, say N.

	  To compile this driver as a module, choose M here.
```

## drivers/usb/legacy/aotg_udc/Kconfig
```kconfig
config USB_LEGACY_AOTG_UDC
	tristate "Actions legacy usb2.0 udc support"
	depends on USB_LEGACY
	default n
	---help---
	  The Actions chips have USB2.0 otg controllers. Enable
	  this option if your board uses this chip. If unsure, say N.

	  To compile this driver as a module, choose M here.

config USB_LEGACY_AOTG_ADFU
	tristate "Actions legacy usb2.0 udc_adfu support"
	depends on USB_LEGACY
	default n
	---help---
	  The Actions chips have USB2.0 otg controllers. Enable
	  this option if your board uses this chip. If unsure, say N.

	  To compile this driver as a module, choose M here.
```

## drivers/usb/legacy/monitor/Kconfig
```kconfig
config USB_LEGACY_MONITOR
	tristate "Actions legacy usb2.0 monitor support"
	depends on USB_LEGACY
	default n
	---help---
	  The Actions chips have USB2.0 otg controllers. Enable
	  this option if your board uses this chip. If unsure, say N.

	  To compile this driver as a module, choose M here.
```

## drivers/video/owl/dss/controller/Kconfig
```kconfig
config VIDEO_OWL_CONTROLLERS
	depends on VIDEO_OWL_DSS
	tristate "OWL Display Controllers support"
	---help---
	  Actions OWL Soc Display Controllers support.

	  Say Y here if you need it in your system.
	  If unsure, say Y.

	  To compile this driver as a module, choose M here.

config VIDEO_OWL_EDPC
	depends on VIDEO_OWL_CONTROLLERS
	tristate "OWL EDP Controllers support"
	---help---
	  Actions OWL Soc EDP Controller support.

	  Say Y here if you need it in your system.
	  If unsure, say Y.

	  To compile this driver as a module, choose M here.
	  
config VIDEO_OWL_DSIC
	depends on VIDEO_OWL_CONTROLLERS
	tristate "OWL MIPI Controllers support"
	---help---
	  Actions OWL Soc MIPI Controller support.

	  Say Y here if you need it in your system.
	  If unsure, say Y.

	  To compile this driver as a module, choose M here.	  

config VIDEO_OWL_HDMIC
	depends on VIDEO_OWL_CONTROLLERS
	tristate "OWL HDMI Controllers support"
	---help---
	  Actions OWL Soc HDMI Controller support.

	  Say Y here if you need it in your system.
	  If unsure, say Y.

	  To compile this driver as a module, choose M here.

config VIDEO_OWL_DUMMY_DISPC
	depends on VIDEO_OWL_CONTROLLERS
	tristate "OWL Dummy Controllers support"
	---help---
	  Actions OWL Soc Dummy Controller support.

	  Say Y here if you need it in your system.
	  If unsure, say Y.

	  To compile this driver as a module, choose M here.

if VIDEO_OWL_HDMIC
source "drivers/video/owl/dss/controller/hdmic/Kconfig"
endif
if VIDEO_OWL_DSIC
source "drivers/video/owl/dss/controller/dsic/Kconfig"
endif
```

## drivers/video/owl/dss/panel/Kconfig
```kconfig
config VIDEO_OWL_PANELS
	depends on VIDEO_OWL_DSS
	tristate "OWL Display Panels support"
	---help---
	  Actions OWL Soc Display Panels support.

	  Say Y here if you need it in your system.
	  If unsure, say Y.

	  To compile this driver as a module, choose M here.

config VIDEO_OWL_GEP
	depends on VIDEO_OWL_PANELS
	tristate "OWL Generic EDP Panel support"
	---help---
	  Actions OWL Soc Generic EDP Panel support.

	  Say Y here if you need it in your system.
	  If unsure, say Y.

	  To compile this driver as a module, choose M here.

config VIDEO_OWL_GMP
	depends on VIDEO_OWL_PANELS
	tristate "OWL Generic MIPI Panel support"
	---help---
	  Actions OWL Soc Generic MIPI Panel support.

	  Say Y here if you need it in your system.
	  If unsure, say Y.

	  To compile this driver as a module, choose M here.

config VIDEO_OWL_GHP
	depends on VIDEO_OWL_PANELS
	tristate "OWL Generic HDMI Panel support"
	---help---
	  Actions OWL Soc Generic HDMI Panel support.

	  Say Y here if you need it in your system.
	  If unsure, say Y.

	  To compile this driver as a module, choose M here.

config VIDEO_OWL_GDP
	depends on VIDEO_OWL_PANELS
	tristate "OWL Generic Dummy Panel support"
	---help---
	  Actions OWL Soc Generic Dummy Panel support.

	  Say Y here if you need it in your system.
	  If unsure, say Y.

	  To compile this driver as a module, choose M here.
```

## sound/soc/atc260x-new/Kconfig
```kconfig
config SND_SOC_ACT_OWL
	tristate
	depends on SND_SOC

config SND_SOC_ACT_2603C
	tristate
	depends on SND_SOC_ACT_OWL

config SND_SOC_ACT_NAU85L40
	tristate
	depends on SND_SOC_ACT_OWL

config SND_SOC_ACT_DAI_OWL_I2S
	tristate
	depends on SND_SOC_ACT_OWL


config SND_SOC_ACT_DAI_OWL_HDMI
	tristate
	depends on SND_SOC_ACT_OWL

config SND_SOC_ACT_DAI_OWL_SPI
	tristate
	depends on SND_SOC_ACT_OWL

config SND_SOC_ACT_DAI_OWL_I2S_6WIRE
	tristate
	depends on SND_SOC_ACT_OWL

config SND_SOC_ACT_ALL_PMU_OWL
	tristate "SoC Audio support for all pmus owl board(new)"
	select SND_SOC_ACT_OWL
	select SND_SOC_ACT_DAI_OWL_I2S
	select SND_SOC_ACT_2603C
	help
	  Say Y if you want to add support for SoC audio on 
	  S500 board.

config SND_SOC_ACT_ALL_PMU_OWL_6WIRE
	tristate "SoC Audio support for all pmus and 6wire codec on owl  board"
	select SND_SOC_ACT_OWL
	select SND_SOC_ACT_DAI_OWL_I2S_6WIRE
	select SND_SOC_ACT_2603C
	help
	  Say Y if you want to add support for SoC audio on 
	  S500 board.
	  
config SND_SOC_ACT_ALL_PMU_OWL_3605_NAU85L40
	tristate "SoC Audio support for all pmus and nau85l40 on owl 3605 board"
	select SND_SOC_ACT_OWL
	select SND_SOC_ACT_DAI_OWL_I2S
	select SND_SOC_ACT_DAI_OWL_SPI
	select SND_SOC_ACT_2603C
	select SND_SOC_ACT_NAU85L40
	help
	  Say Y if you want to add support for SoC audio on 
	  S500 board.
	  
config SND_SOC_ACT_OWL_HDMI
	tristate "SoC Audio support for OWL HDMI"
	select SND_SOC_ACT_OWL
	select SND_SOC_ACT_DAI_OWL_HDMI
	help
	  Say Y if you want to add support for SoC HDMI audio on 
	  owl board.
```
